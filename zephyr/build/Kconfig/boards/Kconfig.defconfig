## zephyr/build/Kconfig/boards/Kconfig.defconfig
```kconfig
# Load Zephyr board defconfig descriptions.
osource "/home/krishna-inc-5836/zephyrproject/zephyr/boards/st/nucleo_g474re/Kconfig.defconfig"
```

## zephyr/build/Kconfig/boards/Kconfig.nucleo_g474re
```kconfig
# Load board Kconfig descriptions.
osource "/home/krishna-inc-5836/zephyrproject/zephyr/boards/st/nucleo_g474re/Kconfig.nucleo_g474re"
```
